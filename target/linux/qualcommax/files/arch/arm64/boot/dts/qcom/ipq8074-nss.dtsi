// SPDX-License-Identifier: (GPL-2.0-only OR BSD-2-Clause)

#include <dt-bindings/clock/qcom,gcc-ipq8074.h>
#include <dt-bindings/interrupt-controller/arm-gic.h>

&soc {
	nss: network-processor@39000000 {
		compatible = "qcom,ipq8074-nss";
		reg = <0x39000000 0x1000>,
		      <0x39400000 0x1000>,
		      <0x38000000 0x30000>,
		      <0x38030000 0x30000>;
		reg-names = "csm0", "csm1", "imem0", "imem1";

		memory-region = <&nss_region>;
		qcom,edma = <&edma>;
		qcom,ppe = <&switch>;

		interrupts = <GIC_SPI 377 IRQ_TYPE_EDGE_RISING>,
			     <GIC_SPI 378 IRQ_TYPE_EDGE_RISING>,
			     <GIC_SPI 379 IRQ_TYPE_EDGE_RISING>,
			     <GIC_SPI 380 IRQ_TYPE_EDGE_RISING>,
			     <GIC_SPI 381 IRQ_TYPE_EDGE_RISING>,
			     <GIC_SPI 382 IRQ_TYPE_EDGE_RISING>,
			     <GIC_SPI 383 IRQ_TYPE_EDGE_RISING>,
			     <GIC_SPI 384 IRQ_TYPE_EDGE_RISING>,
			     <GIC_SPI 385 IRQ_TYPE_EDGE_RISING>,
			     <GIC_SPI 386 IRQ_TYPE_EDGE_RISING>,
			     <GIC_SPI 390 IRQ_TYPE_EDGE_RISING>,
			     <GIC_SPI 391 IRQ_TYPE_EDGE_RISING>,
			     <GIC_SPI 392 IRQ_TYPE_EDGE_RISING>,
			     <GIC_SPI 393 IRQ_TYPE_EDGE_RISING>,
			     <GIC_SPI 394 IRQ_TYPE_EDGE_RISING>,
			     <GIC_SPI 395 IRQ_TYPE_EDGE_RISING>,
			     <GIC_SPI 396 IRQ_TYPE_EDGE_RISING>,
			     <GIC_SPI 397 IRQ_TYPE_EDGE_RISING>,
			     <GIC_SPI 398 IRQ_TYPE_EDGE_RISING>,
			     <GIC_SPI 399 IRQ_TYPE_EDGE_RISING>;
		interrupt-names = "empty-buffer0",
				  "empty-return0",
				  "tx-unblocked0",
				  "data0-0",
				  "data0-1",
				  "data0-2",
				  "data0-3",
				  "coredump0",
				  "paged-buffer0",
				  "profile0",
				  "empty-buffer1",
				  "empty-return1",
				  "tx-unblocked1",
				  "data1-0",
				  "data1-1",
				  "data1-2",
				  "data1-3",
				  "coredump1",
				  "paged-buffer1",
				  "profile1";

		clocks = <&gcc GCC_NSS_NOC_CLK>,
			 <&gcc GCC_NSS_PTP_REF_CLK>,
			 <&gcc GCC_NSS_CSR_CLK>,
			 <&gcc GCC_NSS_CFG_CLK>,
			 <&gcc GCC_NSS_IMEM_CLK>,
			 <&gcc GCC_NSSNOC_QOSGEN_REF_CLK>,
			 <&gcc GCC_MEM_NOC_NSS_AXI_CLK>,
			 <&gcc GCC_NSSNOC_SNOC_CLK>,
			 <&gcc GCC_NSSNOC_TIMEOUT_REF_CLK>,
			 <&gcc GCC_NSS_CE_AXI_CLK>,
			 <&gcc GCC_NSS_CE_APB_CLK>,
			 <&gcc GCC_NSSNOC_CE_AXI_CLK>,
			 <&gcc GCC_NSSNOC_CE_APB_CLK>,
			 <&gcc GCC_NSS_CRYPTO_CLK>,
			 <&gcc GCC_NSSNOC_CRYPTO_CLK>,
			 <&gcc GCC_UBI0_CORE_CLK>,
			 <&gcc GCC_NSSNOC_UBI0_AHB_CLK>,
			 <&gcc GCC_UBI0_AHB_CLK>,
			 <&gcc GCC_UBI0_AXI_CLK>,
			 <&gcc GCC_UBI0_MPT_CLK>,
			 <&gcc GCC_UBI0_NC_AXI_CLK>,
			 <&gcc GCC_UBI1_CORE_CLK>,
			 <&gcc GCC_NSSNOC_UBI1_AHB_CLK>,
			 <&gcc GCC_UBI1_AHB_CLK>,
			 <&gcc GCC_UBI1_AXI_CLK>,
			 <&gcc GCC_UBI1_MPT_CLK>,
			 <&gcc GCC_UBI1_NC_AXI_CLK>;
		clock-names = "noc",
			      "ptp-ref",
			      "csr",
			      "cfg",
			      "imem",
			      "qosgen",
			      "mem-noc",
			      "snoc",
			      "timeout",
			      "ce-axi",
			      "ce-apb",
			      "noc-ce-axi",
			      "noc-ce-apb",
			      "crypto",
			      "noc-crypto",
			      "core0",
			      "noc-ahb0",
			      "ahb0",
			      "axi0",
			      "mpt0",
			      "nc-axi0",
			      "core1",
			      "noc-ahb1",
			      "ahb1",
			      "axi1",
			      "mpt1",
			      "nc-axi1";

		resets = <&gcc GCC_UBI0_CLKRST_CLAMP_ENABLE>,
			 <&gcc GCC_UBI0_AXI_ARES>,
			 <&gcc GCC_UBI0_AHB_ARES>,
			 <&gcc GCC_UBI0_NC_AXI_ARES>,
			 <&gcc GCC_UBI0_CORE_CLAMP_ENABLE>,
			 <&gcc GCC_UBI1_CLKRST_CLAMP_ENABLE>,
			 <&gcc GCC_UBI1_AXI_ARES>,
			 <&gcc GCC_UBI1_AHB_ARES>,
			 <&gcc GCC_UBI1_NC_AXI_ARES>,
			 <&gcc GCC_UBI1_CORE_CLAMP_ENABLE>,
			 <&gcc GCC_NSS_CE_AXI_ARES>,
			 <&gcc GCC_NSS_CE_APB_ARES>,
			 <&gcc GCC_NSSNOC_CE_AXI_ARES>,
			 <&gcc GCC_NSSNOC_CE_APB_ARES>,
			 <&gcc GCC_NSS_CRYPTO_ARES>,
			 <&gcc GCC_NSSNOC_CRYPTO_ARES>;
		reset-names = "clkrst0",
			      "axi0",
			      "ahb0",
			      "nc-axi0",
			      "core0",
			      "clkrst1",
			      "axi1",
			      "ahb1",
			      "nc-axi1",
			      "core1",
			      "ce-axi",
			      "ce-apb",
			      "noc-ce-axi",
			      "noc-ce-apb",
			      "crypto",
			      "noc-crypto";

		mboxes = <&apcs_glb 13>,
			 <&apcs_glb 14>,
			 <&apcs_glb 15>,
			 <&apcs_glb 16>,
			 <&apcs_glb 17>,
			 <&apcs_glb 19>,
			 <&apcs_glb 20>,
			 <&apcs_glb 21>,
			 <&apcs_glb 22>,
			 <&apcs_glb 23>;
		mbox-names = "empty0",
			     "command0",
			     "unblocked0",
			     "coredump0",
			     "paged0",
			     "empty1",
			     "command1",
			     "unblocked1",
			     "coredump1",
			     "paged1";

		status = "disabled";
	};
};
